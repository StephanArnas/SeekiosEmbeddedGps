/**
 * \brief Initializes generators

 */
void _gclk_init_generators(void)
{
	void *hw = (void *)GCLK;

#if CONF_GCLK_GEN_0_GENEN == 1
	hri_gclk_write_GENCTRL_reg(hw, 0,
			GCLK_GENCTRL_DIV(CONF_GCLK_GEN_0_DIV) |
			(CONF_GCLK_GEN_0_RUNSTDBY << GCLK_GENCTRL_RUNSTDBY_Pos) |
			(CONF_GCLK_GEN_0_DIVSEL << GCLK_GENCTRL_DIVSEL_Pos) |
			(CONF_GCLK_GEN_0_OE << GCLK_GENCTRL_OE_Pos) |
			(CONF_GCLK_GEN_0_OOV << GCLK_GENCTRL_OOV_Pos) |
			(CONF_GCLK_GEN_0_IDC << GCLK_GENCTRL_IDC_Pos) |
			(CONF_GCLK_GEN_0_GENEN << GCLK_GENCTRL_GENEN_Pos) |
			CONF_GCLK_GEN_0_SOURCE);
#endif
#if CONF_GCLK_GEN_1_GENEN == 1
	hri_gclk_write_GENCTRL_reg(hw, 1,
			GCLK_GENCTRL_DIV(CONF_GCLK_GEN_1_DIV) |
			(CONF_GCLK_GEN_1_RUNSTDBY << GCLK_GENCTRL_RUNSTDBY_Pos) |
			(CONF_GCLK_GEN_1_DIVSEL << GCLK_GENCTRL_DIVSEL_Pos) |
			(CONF_GCLK_GEN_1_OE << GCLK_GENCTRL_OE_Pos) |
			(CONF_GCLK_GEN_1_OOV << GCLK_GENCTRL_OOV_Pos) |
			(CONF_GCLK_GEN_1_IDC << GCLK_GENCTRL_IDC_Pos) |
			(CONF_GCLK_GEN_1_GENEN << GCLK_GENCTRL_GENEN_Pos) |
			CONF_GCLK_GEN_1_SOURCE);
#endif
#if CONF_GCLK_GEN_2_GENEN == 1
	hri_gclk_write_GENCTRL_reg(hw, 2,
			GCLK_GENCTRL_DIV(CONF_GCLK_GEN_2_DIV) |
			(CONF_GCLK_GEN_2_RUNSTDBY << GCLK_GENCTRL_RUNSTDBY_Pos) |
			(CONF_GCLK_GEN_2_DIVSEL << GCLK_GENCTRL_DIVSEL_Pos) |
			(CONF_GCLK_GEN_2_OE << GCLK_GENCTRL_OE_Pos) |
			(CONF_GCLK_GEN_2_OOV << GCLK_GENCTRL_OOV_Pos) |
			(CONF_GCLK_GEN_2_IDC << GCLK_GENCTRL_IDC_Pos) |
			(CONF_GCLK_GEN_2_GENEN << GCLK_GENCTRL_GENEN_Pos) |
			CONF_GCLK_GEN_2_SOURCE);
#endif
#if CONF_GCLK_GEN_3_GENEN == 1
	hri_gclk_write_GENCTRL_reg(hw, 3,
			GCLK_GENCTRL_DIV(CONF_GCLK_GEN_3_DIV) |
			(CONF_GCLK_GEN_3_RUNSTDBY << GCLK_GENCTRL_RUNSTDBY_Pos) |
			(CONF_GCLK_GEN_3_DIVSEL << GCLK_GENCTRL_DIVSEL_Pos) |
			(CONF_GCLK_GEN_3_OE << GCLK_GENCTRL_OE_Pos) |
			(CONF_GCLK_GEN_3_OOV << GCLK_GENCTRL_OOV_Pos) |
			(CONF_GCLK_GEN_3_IDC << GCLK_GENCTRL_IDC_Pos) |
			(CONF_GCLK_GEN_3_GENEN << GCLK_GENCTRL_GENEN_Pos) |
			CONF_GCLK_GEN_3_SOURCE);
#endif
#if CONF_GCLK_GEN_4_GENEN == 1
	hri_gclk_write_GENCTRL_reg(hw, 4,
			GCLK_GENCTRL_DIV(CONF_GCLK_GEN_4_DIV) |
			(CONF_GCLK_GEN_4_RUNSTDBY << GCLK_GENCTRL_RUNSTDBY_Pos) |
			(CONF_GCLK_GEN_4_DIVSEL << GCLK_GENCTRL_DIVSEL_Pos) |
			(CONF_GCLK_GEN_4_OE << GCLK_GENCTRL_OE_Pos) |
			(CONF_GCLK_GEN_4_OOV << GCLK_GENCTRL_OOV_Pos) |
			(CONF_GCLK_GEN_4_IDC << GCLK_GENCTRL_IDC_Pos) |
			(CONF_GCLK_GEN_4_GENEN << GCLK_GENCTRL_GENEN_Pos) |
			CONF_GCLK_GEN_4_SOURCE);
#endif
#if CONF_GCLK_GEN_5_GENEN == 1
	hri_gclk_write_GENCTRL_reg(hw, 5,
			GCLK_GENCTRL_DIV(CONF_GCLK_GEN_5_DIV) |
			(CONF_GCLK_GEN_5_RUNSTDBY << GCLK_GENCTRL_RUNSTDBY_Pos) |
			(CONF_GCLK_GEN_5_DIVSEL << GCLK_GENCTRL_DIVSEL_Pos) |
			(CONF_GCLK_GEN_5_OE << GCLK_GENCTRL_OE_Pos) |
			(CONF_GCLK_GEN_5_OOV << GCLK_GENCTRL_OOV_Pos) |
			(CONF_GCLK_GEN_5_IDC << GCLK_GENCTRL_IDC_Pos) |
			(CONF_GCLK_GEN_5_GENEN << GCLK_GENCTRL_GENEN_Pos) |
			CONF_GCLK_GEN_5_SOURCE);
#endif
#if CONF_GCLK_GEN_6_GENEN == 1
	hri_gclk_write_GENCTRL_reg(hw, 6,
			GCLK_GENCTRL_DIV(CONF_GCLK_GEN_6_DIV) |
			(CONF_GCLK_GEN_6_RUNSTDBY << GCLK_GENCTRL_RUNSTDBY_Pos) |
			(CONF_GCLK_GEN_6_DIVSEL << GCLK_GENCTRL_DIVSEL_Pos) |
			(CONF_GCLK_GEN_6_OE << GCLK_GENCTRL_OE_Pos) |
			(CONF_GCLK_GEN_6_OOV << GCLK_GENCTRL_OOV_Pos) |
			(CONF_GCLK_GEN_6_IDC << GCLK_GENCTRL_IDC_Pos) |
			(CONF_GCLK_GEN_6_GENEN << GCLK_GENCTRL_GENEN_Pos) |
			CONF_GCLK_GEN_6_SOURCE);
#endif
#if CONF_GCLK_GEN_7_GENEN == 1
	hri_gclk_write_GENCTRL_reg(hw, 7,
			GCLK_GENCTRL_DIV(CONF_GCLK_GEN_7_DIV) |
			(CONF_GCLK_GEN_7_RUNSTDBY << GCLK_GENCTRL_RUNSTDBY_Pos) |
			(CONF_GCLK_GEN_7_DIVSEL << GCLK_GENCTRL_DIVSEL_Pos) |
			(CONF_GCLK_GEN_7_OE << GCLK_GENCTRL_OE_Pos) |
			(CONF_GCLK_GEN_7_OOV << GCLK_GENCTRL_OOV_Pos) |
			(CONF_GCLK_GEN_7_IDC << GCLK_GENCTRL_IDC_Pos) |
			(CONF_GCLK_GEN_7_GENEN << GCLK_GENCTRL_GENEN_Pos) |
			CONF_GCLK_GEN_7_SOURCE);
#endif
}

